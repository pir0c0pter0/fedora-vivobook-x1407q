// SPDX-License-Identifier: BSD-3-Clause
/* DTS de teste da frente TOUCHSCREEN: gwnb1 + fragments/yoga-touchscreen.dtsi */

#include "kalambo-lenovo-yoga-slim7x-gwnb1.dts"
#include "yoga-touchscreen.dtsi"
