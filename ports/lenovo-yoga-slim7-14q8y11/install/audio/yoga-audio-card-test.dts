// SPDX-License-Identifier: BSD-3-Clause
/* DTB de teste da placa de som: gwnx1 (slot current) + fragments/yoga-audio-card.dtsi */
#include "kalambo-lenovo-yoga-slim7x-gwnx1.dts"
#include "yoga-audio-card.dtsi"
